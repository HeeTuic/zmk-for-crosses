## config/boards/shields/crosses/Kconfig.shield
```kconfig
config SHIELD_CROSSES_LEFT
    def_bool $(shields_list_contains,crosses36_left)

config SHIELD_CROSSES_RIGHT
    def_bool $(shields_list_contains,crosses36_right)
```
